## conf/layer.conf
```bitbake
# We have a conf and classes directory, add to BBPATH
BBPATH .= ":${LAYERDIR}"

# We have recipes-* directories, add to BBFILES
BBFILES += "${LAYERDIR}/recipes-*/*/*.bb"

BBFILE_COLLECTIONS += "meta-uitest"
BBFILE_PATTERN_meta-uitest = "^${LAYERDIR}/"
BBFILE_PRIORITY_meta-uitest = "6"
```
